## firmware/main/Kconfig.projbuild
```kconfig
menu "Scorbot"

    choice SCORBOT_DRIVER
        prompt "Motor driver carriers"
        default SCORBOT_DRIVER_CGW
        help
            All six carriers must be the same type. Sets the current-sense
            scaling, the driver's current limit and the default software trip.

        config SCORBOT_DRIVER_CGW
            bool "DRV8874, hardware/drv8874-carrier (2.4k CS: 1.08 V/A, ~3.1 A)"
        config SCORBOT_DRIVER_POLOLU_4035
            bool "DRV8874, Pololu #4035 (2.49k CS: 1.12 V/A, ~2.9 A)"
        config SCORBOT_DRIVER_POLOLU_4036
            bool "DRV8876, Pololu #4036 (2.49 V/A, ~1.33 A, 1.2 A trip)"
    endchoice

endmenu
```

## firmware/sdkconfig.defaults
```kconfig
CONFIG_IDF_TARGET="esp32"
CONFIG_ESPTOOLPY_FLASHSIZE_4MB=y
CONFIG_PARTITION_TABLE_CUSTOM=y
CONFIG_PARTITION_TABLE_CUSTOM_FILENAME="partitions.csv"
CONFIG_BOOTLOADER_APP_ROLLBACK_ENABLE=y
CONFIG_MBEDTLS_CERTIFICATE_BUNDLE=y
CONFIG_ESP_HTTPS_OTA_ALLOW_HTTP=n
CONFIG_FREERTOS_HZ=1000
CONFIG_HTTPD_WS_SUPPORT=y
CONFIG_HTTPD_MAX_REQ_HDR_LEN=1024
CONFIG_ESP_MAIN_TASK_STACK_SIZE=8192
CONFIG_LWIP_MAX_SOCKETS=16
CONFIG_COMPILER_OPTIMIZATION_PERF=y
```
